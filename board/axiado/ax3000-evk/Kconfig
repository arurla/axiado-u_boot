## board/axiado/ax3000-evk/Kconfig
```kconfig
if AX3000_EVK

config SYS_BOARD
        string
        default "ax3000-evk"

config SYS_VENDOR
        string
        default "axiado"

config SYS_CONFIG_NAME
        string
        default "ax3000-evk"
	
endif
```

## configs/axiado_ax200_defconfig
```kconfig
# Custom Configuration file specific for Axiado ax200 SOC
#Copyright (c) 2021-22 Axiado Corporation (or its affiliates). All rights reserved.
#Use, modification and redistribution of this file is subject to your possession
#of a valid End User License Agreement (EULA) for the Axiado Product of which
#these sources are part of and your compliance with all applicable terms and
#conditions of such licence agreement.

CONFIG_ARM=y
CONFIG_ARM64=y
CONFIG_ARMV8_SET_SMPEN=y
CONFIG_ARMV8_MULTIENTRY=y
CONFIG_ARMV8_SPIN_TABLE=y
CONFIG_SYS_ARCH="arm"
CONFIG_SYS_CPU="armv8"
CONFIG_POSITION_INDEPENDENT=y

CONFIG_SYS_ARCH_TIMER=y

# CONFIG_SYS_L2CACHE_OFF=y

CONFIG_ENV_SIZE=0x2000
CONFIG_SYS_TEXT_BASE=0x3C000000
CONFIG_NR_DRAM_BANKS=4
CONFIG_SYS_MALLOC_LEN=0x20000
CONFIG_SYS_MALLOC_F_LEN=0x8000
# CONFIG_SYS_MEMTEST_START=0x00000000
# CONFIG_SYS_MEMTEST_END=0x00001000

CONFIG_SYS_LOAD_ADDR=0x3D000000

CONFIG_SYS_BOOT_RAMDISK_HIGH=y

# CONFIG_SYS_ICACHE_OFF=y
# CONFIG_SYS_DCACHE_OFF=y
CONFIG_PLATFORM_ELFENTRY="_start"
CONFIG_FIT=y
CONFIG_DM=y

CONFIG_GICV3=y
CONFIG_GIC_V3_ITS=y

CONFIG_SYS_PROMPT="U-Boot> "
#CONFIG_USE_BOOTARGS=y
#CONFIG_BOOTARGS="console=ttyPS0,9600 earlyprintk maxcpus=1 earlycon root=/dev/ram0 init=/init rw rootfstype=tmpfs debug"

CONFIG_GZIP=y

CONFIG_CMD_FRU=y
CONFIG_USE_PREBOOT=y
# CONFIG_DISPLAY_CPUINFO is not set
CONFIG_CMD_BOOTMENU=y
CONFIG_CMD_NVEDIT_EFI=y
CONFIG_CMD_MEMTEST=y
CONFIG_SYS_ALT_MEMTEST=y
CONFIG_CMD_CLK=y
CONFIG_CMD_DFU=y
CONFIG_CMD_MTD=y
CONFIG_CMD_SF_TEST=y
CONFIG_CMD_SPI=y
CONFIG_CMD_TFTPPUT=y
CONFIG_CMD_BMP=y
CONFIG_CMD_CACHE=y
CONFIG_CMD_REGULATOR=y
CONFIG_CMD_TPM=y

CONFIG_USE_ARCH_MEMSET=y
CONFIG_TINY_MEMSET=y

CONFIG_OF_LIST="axiado-ax200"
CONFIG_OF_CONTROL=y
CONFIG_OF_EMBED=y
CONFIG_MULTI_DTB_FIT=y
CONFIG_DEFAULT_DEVICE_TREE="axiado-ax200"
CONFIG_DEFAULT_FDT_FILE="axiado-ax200.dtb"
CONFIG_SYS_CUSTOM_LDSCRIPT=y
CONFIG_SYS_LDSCRIPT="arch/arm/cpu/armv8/u-boot.lds"

CONFIG_ARMV8_NONSEC=y

CONFIG_SYS_CONSOLE_IS_IN_ENV=y

CONFIG_DM_SERIAL=y
CONFIG_DM_STDIO=y
CONFIG_BAUDRATE=115200
CONFIG_REQUIRE_SERIAL_CONSOLE=y
CONFIG_SERIAL_PRESENT=y
CONFIG_ZYNQ_SERIAL=y

# CONFIG_DEBUG=y
# CONFIG_DEBUG_UART=y
# CONFIG_DEBUG_UART_BASE=0x80520800
# CONFIG_DEBUG_UART_CLOCK=1250000
# CONFIG_DEBUG_UART_ANNOUNCE=y

CONFIG_DISPLAY=y

#CONFIG_AUTOBOOT=y
#CONFIG_BOOTDELAY=1
#CONFIG_USE_BOOTCOMMAND=y
#CONFIG_BOOTCOMMAND="run distro_bootcmd"

# CONFIG_SYS_RELOC_GD_ENV_ADDR=y

# CONFIG_DM_I2C=y
# CONFIG_SYS_I2C_CADENCE=y
# CONFIG_XILINX_UARTLITE=y

CONFIG_MMC=n
# CONFIG_ENV_IS_NOWHERE=y
```
